#include "soc/gpio_sig_map.h"
#include "stdint.h"
#include "HardwareSerial.h"
#define I2C_SLAVE_ADDR 0x04


////////////camera_serilaの変数/////////

camera_fb_t* fb = NULL;
esp_err_t res = ESP_OK;

uint8_t* test_buf = NULL;
uint8_t red = 0, green = 0, blue = 0;
const uint16_t max_h_pix = 32;
const uint16_t max_v_pix = 32;
int rgb_16_line;
int counter;
const char frag = 'h';

int red_sum[32][32];
int green_sum = 0;
int blue_sum = 0;


uint16_t Image_Buffer[32][32] = {
  //カメラ画像を格納する配列
  { 0, 0, 0, 0, 0, 0, 0, 0, 0, 0, 0, 0, 0, 0, 0, 0, 0, 0, 0, 0, 0, 0, 0, 0, 0, 0, 0, 0, 0, 0, 0, 0 },
  { 0, 0, 0, 0, 0, 0, 0, 0, 0, 0, 0, 0, 0, 0, 0, 0, 0, 0, 0, 0, 0, 0, 0, 0, 0, 0, 0, 0, 0, 0, 0, 0 },
  { 0, 0, 0, 0, 0, 0, 0, 0, 0, 0, 0, 0, 0, 0, 0, 0, 0, 0, 0, 0, 0, 0, 0, 0, 0, 0, 0, 0, 0, 0, 0, 0 },
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  { 0, 0, 0, 0, 0, 0, 0, 0, 0, 0, 0, 0, 0, 0, 0, 0, 0, 0, 0, 0, 0, 0, 0, 0, 0, 0, 0, 0, 0, 0, 0, 0 },



};





///////////////////////////////////////

////////////wire_cameraの変数/////////

unsigned long lastWireTransmit = 0;
byte x = 0;



///////////////////////////////////////


void camera_serial() {

  WirePacker packer;



  fb = esp_camera_fb_get();
  if (!fb) {
    Serial.println("Camera capture failed");
    return;
  }
  ////////////////カメラからRGB値を取得する/////////////////////////
  //*test_bufポインタには、red, green, blue の各データが順番に格納*//

  test_buf = fb->buf;

  ///////////////////////////////////////////////////////////////


  ///////////////////32*32のピクセルに変換/////////////////////////

  for (int j = 0; j < 32; j++) {    //縦
    for (int i = 0; i < 32; i++) {  //横
      WirePacker packer;
      red = *(test_buf + j * max_h_pix + i);
      green = *(test_buf + j * max_h_pix + (i + 1));
      blue = *(test_buf + j * max_h_pix + (i + 2));
       


      /////////////各RGB値を文字列に変換////////////////////////
      ///送るデータにヘッダをつける
      //最初に二次元配列をマスター側に送るのほうが理解しやすい
      //まったく安定感がない
      //最初にpみたいなフラグを送る
      //そのあとにｘとｙ座標を（xとyをカウント）
      



   
      Serial.print(" r = ");
      Serial.print(red);
      Serial.print(" g = ");
      Serial.print(green);
      Serial.print(" b = ");
      Serial.println(blue);

     
      //int rgb_16_line = rgb_16.toInt();

      /////////////////////それぞれのRGB値をスレーブに送信/////////////////////

   
   
      packer.write(frag);
      packer.write(red);
      packer.write(green);
      packer.write(blue);
      packer.write(i);
      packer.write(j);
      delay(1);
    

      /////////////////////int型配列の32*32に入れる/////////////////

      /*Image_Buffer[j][i] = rgb_16_line;
      Serial.print("Image_Buffer[");
      Serial.print(j);
      Serial.print("][");
      Serial.print(i);
      Serial.print("]=");
      Serial.println(Image_Buffer[j][i]);*/
 
      packer.end();
      // now transmit the packed data
      Wire.beginTransmission(I2C_SLAVE_ADDR);
      while (packer.available()) {  // write every packet byte
        Wire.write(packer.read());
      }
      Wire.endTransmission();  // stop transmitting*/
    }
    //Serial.println();
  }
  Serial.println("------------------------------------------------------------");

  delay(1000);
}
